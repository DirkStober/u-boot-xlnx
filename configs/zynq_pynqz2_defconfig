## configs/zynq_pynqz2_defconfig
```kconfig
# CONFIG_ARCH_FIXUP_FDT_MEMORY is not set
CONFIG_ARCH_ZYNQ=y
CONFIG_ARM_DCC=y
CONFIG_ARM=y
CONFIG_BOOTCOMMAND="run $modeboot || run distro_bootcmd"
# CONFIG_BOOTM_NETBSD is not set
CONFIG_CFI_FLASH=y
CONFIG_CI_UDC=y
CONFIG_CMD_CACHE=y
CONFIG_CMD_DFU=y
CONFIG_CMD_EFIDEBUG=y
CONFIG_CMD_EXT4_WRITE=y
CONFIG_CMD_FPGA_LOADBP=y
CONFIG_CMD_FPGA_LOADFS=y
CONFIG_CMD_FPGA_LOADMK=y
CONFIG_CMD_FPGA_LOADP=y
CONFIG_CMD_FRU=y
CONFIG_CMD_GPIO=y
CONFIG_CMD_I2C=y
CONFIG_CMD_IMLS=y
CONFIG_CMD_MEMTEST=y
CONFIG_CMD_MMC=y
CONFIG_CMD_MTDPARTS_SHOW_NET_SIZES=y
CONFIG_CMD_MTDPARTS_SPREAD=y
CONFIG_CMD_MTDPARTS=y
CONFIG_CMD_MTD=y
CONFIG_CMD_NAND_LOCK_UNLOCK=y
# CONFIG_CMD_SETEXPR is not set
CONFIG_CMD_SF_TEST=y
CONFIG_CMD_SF=y
CONFIG_CMD_TFTPPUT=y
CONFIG_CMD_THOR_DOWNLOAD=y
CONFIG_CMD_TIMER=y
CONFIG_CMD_TIME=y
CONFIG_CMD_UBI=y
CONFIG_CMD_USB=y
CONFIG_CMD_ZYNQ_AES=y
CONFIG_DEBUG_UART_BASE=0xe0000000
CONFIG_DEBUG_UART_CLOCK=50000000
CONFIG_DEBUG_UART=y
CONFIG_DEBUG_UART_ZYNQ=y
CONFIG_DEFAULT_DEVICE_TREE="zynq-pynqz2"
CONFIG_DFU_MMC=y
CONFIG_DFU_RAM=y
CONFIG_DFU_SF=y
CONFIG_DFU_TIMEOUT=y
# CONFIG_DISPLAY_CPUINFO is not set
CONFIG_DISPLAY=y
CONFIG_DISTRO_DEFAULTS=y
CONFIG_DM_ETH_PHY=y
CONFIG_DM_GPIO=y
CONFIG_DM_I2C=y
CONFIG_EFI_CAPSULE_FIRMWARE_RAW=y
CONFIG_EFI_CAPSULE_ON_DISK=y
CONFIG_EFI_RUNTIME_UPDATE_CAPSULE=y
CONFIG_ENV_IS_IN_FAT=y
CONFIG_ENV_IS_IN_NAND=y
CONFIG_ENV_IS_IN_SPI_FLASH=y
CONFIG_ENV_IS_NOWHERE=y
CONFIG_ENV_OFFSET=0xE00000
CONFIG_ENV_OFFSET_REDUND=0xE40000
CONFIG_FIT_SIGNATURE=y
CONFIG_FIT_VERBOSE=y
CONFIG_FIT=y
CONFIG_FPGA_XILINX=y
CONFIG_FPGA_ZYNQPL=y
CONFIG_I2C_EEPROM=y
CONFIG_I2C_MUX_PCA954x=y
CONFIG_I2C_MUX=y
CONFIG_LED_GPIO=y
CONFIG_LED=y
CONFIG_LEGACY_IMAGE_FORMAT=y
CONFIG_MII=y
CONFIG_MISC=y
CONFIG_MMC_SDHCI=y
CONFIG_MMC_SDHCI_ZYNQ=y
CONFIG_MMC=y
CONFIG_MTD_NOR_FLASH=y
CONFIG_MTD_RAW_NAND=y
CONFIG_MTD=y
CONFIG_NAND_ZYNQ=y
CONFIG_NETCONSOLE=y
CONFIG_NET_RANDOM_ETHADDR=y
CONFIG_OF_LIST="zynq-zc702 zynq-zc706 zynq-zc770-xm010 zynq-zc770-xm011 zynq-zc770-xm011-x16 zynq-zc770-xm012 zynq-zc770-xm013 zynq-cc108 zynq-microzed zynq-minized zynq-picozed zynq-zed zynq-zturn zynq-zturn-v5 zynq-zybo zynq-zybo-z7 zynq-dlc20-rev1.0"
CONFIG_PHY_MARVELL=y
CONFIG_PHY_MICREL_KSZ90X1=y
CONFIG_PHY_MICREL=y
CONFIG_PHY_REALTEK=y
CONFIG_PHY_XILINX=y
CONFIG_SET_DFU_ALT_INFO=y
CONFIG_SF_DEFAULT_SPEED=30000000
CONFIG_SPI_FLASH_BAR=y
CONFIG_SPI_FLASH_ISSI=y
CONFIG_SPI_FLASH_MACRONIX=y
CONFIG_SPI_FLASH_SPANSION=y
CONFIG_SPI_FLASH_SST=y
CONFIG_SPI_FLASH_STMICRO=y
CONFIG_SPI_FLASH_WINBOND=y
CONFIG_SPI_FLASH=y
CONFIG_SPL_DM_MMC=y
CONFIG_SPL_DM_SEQ_ALIAS=y
CONFIG_SPL_FIT_PRINT=y
CONFIG_SPL_FPGA=y
CONFIG_SPL_GZIP=y
CONFIG_SPL_LOAD_FIT_ADDRESS=0x10000000
CONFIG_SPL_LOAD_FIT=y
CONFIG_SPL_OS_BOOT=y
CONFIG_SPL_SPI_LOAD=y
CONFIG_SPL_STACK_R_ADDR=0x200000
CONFIG_SPL_STACK_R=y
CONFIG_SPL_SYS_DCACHE_OFF=y
CONFIG_SPL=y
CONFIG_SYS_ALT_MEMTEST=y
CONFIG_SYS_CONFIG_NAME="zynq_pynqz2"
CONFIG_SYS_CUSTOM_LDSCRIPT=y
CONFIG_SYS_DFU_DATA_BUF_SIZE=0x600000
CONFIG_SYS_FLASH_CFI=y
CONFIG_SYS_FLASH_USE_BUFFER_WRITE=y
CONFIG_SYS_I2C_CADENCE=y
CONFIG_SYS_I2C_EEPROM_ADDR_OVERFLOW=0x0
CONFIG_SYS_LDSCRIPT="arch/arm/mach-zynq/u-boot.lds"
CONFIG_SYS_LOAD_ADDR=0x0
CONFIG_SYS_MEMTEST_END=0x00001000
CONFIG_SYS_MEMTEST_START=0x00000000
CONFIG_SYS_NAND_ONFI_DETECTION=y
CONFIG_SYS_PROMPT="Zynq> "
CONFIG_SYS_REDUNDAND_ENVIRONMENT=y
CONFIG_SYS_RELOC_GD_ENV_ADDR=y
CONFIG_SYS_SPI_U_BOOT_OFFS=0x100000
CONFIG_SYS_TEXT_BASE=0x4000000
CONFIG_USB_EHCI_HCD=y
CONFIG_USB_EHCI=y
CONFIG_USB_EHCI_ZYNQ=y
CONFIG_USB_FUNCTION_THOR=y
CONFIG_USB_GADGET_DOWNLOAD=y
CONFIG_USB_GADGET_MANUFACTURER="Xilinx"
CONFIG_USB_GADGET_PRODUCT_NUM=0x0300
CONFIG_USB_GADGET_VENDOR_NUM=0x03fd
CONFIG_USB_GADGET=y
CONFIG_USB_STORAGE=y
CONFIG_USB_ULPI_VIEWPORT=y
CONFIG_USB_ULPI=y
CONFIG_USB=y
CONFIG_USE_PREBOOT=y
# CONFIG_USE_SPL_FIT_GENERATOR is not set
CONFIG_ZYNQ_GEM_SPI_MAC_OFFSET=0x20
CONFIG_ZYNQ_GEM=y
CONFIG_ZYNQ_QSPI=y
CONFIG_ZYNQ_SERIAL=y
CONFIG_ZYNQ_SPI=y

## Added from ethernet spi .cfg file
CONFIG_CMD_NET=y
CONFIG_NET=y
CONFIG_NET_TFTP_VARS=y
CONFIG_BOOTP_PXE_CLIENTARCH=0x15
CONFIG_BOOTP_VCI_STRING="U-Boot.armv7"
CONFIG_DM_ETH=y
CONFIG_PHYLIB=y
CONFIG_NETDEVICES=y
```
